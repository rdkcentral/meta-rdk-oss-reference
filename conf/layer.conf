## conf/layer.conf
```bitbake
BBPATH .= ":${LAYERDIR}"

BBFILES += "\
            ${LAYERDIR}/recipes-*/*/*.bb \
            ${LAYERDIR}/recipes-*/*/*/*.bb \
            ${LAYERDIR}/recipes-*/*/*/*.bbappend \
            ${LAYERDIR}/recipes-*/*/*.bbappend \
           "

BBFILE_COLLECTIONS += "oss-reference"
BBFILE_PATTERN_oss-reference := "^${LAYERDIR}/"
BBFILE_PRIORITY_oss-reference = "6"

LAYERSERIES_COMPAT_oss-reference = "dunfell kirkstone"
LAYERDEPENDS_oss-reference = "core multimedia-layer"

BBMASK .= "|poky/meta/recipes-core/os-release/os-release.bb"
BBMASK .= "|poky/meta/recipes-core/volatile-binds/volatile-binds.bb"
BBMASK .= "|meta-openembedded/meta-oe/recipes-devtools/giflib/giflib_5.1.4.bb"
BBMASK .= "|poky/meta/recipes-graphics/jpeg/libjpeg-turbo_2.1.4.bb"
BBMASK .= "|meta-rdk-oss-reference/recipes-devtools/perl/perl_%.bbappend"

EXTRA_IMAGE_FEATURES += "ptest-pkgs"
PTESTS_REMOVE:pn-core-image-ptest:append  = " diffutils "
PTEST_ENABLED:pn-bluez5 = "0"
IMAGE_INSTALL:remove = "diffutils-ptest gawk-ptest gdbm-ptest gettext-ptest gzip-ptest m4-ptest openssl-ptest parted-ptest sed-ptest bluez5-ptest busybox-ptest coreutils-ptest findutils-ptest elfutils-ptest  quilt-ptest e2fsprogs-ptest lttng-tools-ptest strace-ptest apr-util-ptest apr-ptest valgrind-ptest  pango-ptest "
LICENSE_FLAGS_ACCEPTED += "GPL-3.0-only"
LICENSE_FLAGS_ACCEPTED += "GPL-3.0-or-later"
PREFERRED_VERSION_libarchive = "3.6.2"
PREFERRED_VERSION_gmp = "6.2.1"
INCOMPATIBLE_LICENSE:remove = " GPL-3.0-only LGPL-3.0-only LGPL-3.0-or-later  GPL-3.0-or-later"
RDEPENDS:remove:pn-core-image-ptest = "diffutils-ptest"
INSANE_SKIP:pn-zlib = "ldflags"
CFLAGS:append:pn-glibc-tests = " -Wno-error=format-overflow"
IMAGE_CLASSES:remove = " apparmor_binprofiles"
```
